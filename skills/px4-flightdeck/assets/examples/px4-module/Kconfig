## skills/px4-flightdeck/assets/examples/px4-module/Kconfig
```kconfig
menuconfig EXAMPLES_FLIGHTDECK_OBSERVER
    bool "flightdeck_observer"
    default n
    ---help---
        Read-only local position observer for learning WorkQueue lifecycle.
```
